## package/couch-libmozjs185/Config.in
```kconfig
config BR2_PACKAGE_COUCH_LIBMOZJS185
	bool "couch-libmozjs185"
	depends on BR2_PACKAGE_LIBNSPR_ARCH_SUPPORT
	depends on BR2_INSTALL_LIBSTDCPP
	depends on !BR2_STATIC_LIBS
	depends on BR2_TOOLCHAIN_HAS_THREADS_NPTL # pthread_getattr_np()
	select BR2_PACKAGE_LIBFFI if !BR2_ARM_CPU_ARMV7M
	select BR2_PACKAGE_LIBNSPR
	help
	  SpiderMonkey JavaScript engine

	  SpiderMonkey is the code-name for the Mozilla's C implementation of
	  JavaScript. It is intended to be embedded in other applications
	  that provide host environments for JavaScript.

	  This is the CouchDB-approved version of this library.

	  https://github.com/apache/couchdb-pkg/tree/master/js

comment "couch-libmozjs185 needs a toolchain with C++, dynamic library, NPTL"
	depends on !BR2_PACKAGE_LIBNSPR_ARCH_SUPPORT
	depends on !BR2_INSTALL_LIBSTDCPP || BR2_STATIC_LIBS || \
		!BR2_TOOLCHAIN_HAS_THREADS_NPTL
```

## package/couchdb/Config.in
```kconfig
comment "CouchDB needs a toolchain with C++, wchar, NPTL, dynamic libs, gcc >= 4.8, host gcc >= 4.8"
	depends on !BR2_BINFMT_FLAT
	depends on BR2_USE_MMU
	depends on !BR2_PACKAGE_ERLANG_ARCH_SUPPORTS
	depends on !BR2_PACKAGE_LIBNSPR_ARCH_SUPPORT
	depends on !BR2_TOOLCHAIN_HAS_THREADS_NPTL || \
		BR2_STATIC_LIBS || !BR2_INSTALL_LIBSTDCPP || \
		!BR2_USE_WCHAR || \
		!BR2_TOOLCHAIN_GCC_AT_LEAST_4_8 || \
		!BR2_HOST_GCC_AT_LEAST_4_8

config BR2_PACKAGE_COUCHDB
	bool "couchdb"
	depends on !BR2_BINFMT_FLAT # icu
	depends on BR2_HOST_GCC_AT_LEAST_4_8 # icu
	depends on BR2_INSTALL_LIBSTDCPP # icu, couch-libmozjs185
	depends on BR2_PACKAGE_ERLANG_ARCH_SUPPORTS
	depends on BR2_PACKAGE_LIBNSPR_ARCH_SUPPORT # couch-libmozjs185
	depends on !BR2_STATIC_LIBS # erlang
	depends on BR2_TOOLCHAIN_HAS_THREADS_NPTL # couch-libmozjs185
	depends on BR2_TOOLCHAIN_GCC_AT_LEAST_4_8 # icu
	depends on BR2_USE_MMU # erlang, couch-libmozjs185
	depends on BR2_USE_WCHAR # icu
	select BR2_PACKAGE_COUCH_LIBMOZJS185
	select BR2_PACKAGE_ERLANG
	select BR2_PACKAGE_ICU
	select BR2_PACKAGE_LIBCURL
	select BR2_PACKAGE_OPENSSL
	help
	  Apache CouchDB database

	  https://couchdb.apache.org/
```

## package/kodi-screensaver-rsxs/Config.in
```kconfig
config BR2_PACKAGE_KODI_SCREENSAVER_RSXS
	bool "kodi-screensaver-rsxs"
	select BR2_PACKAGE_BZIP2
	select BR2_PACKAGE_GLI
	select BR2_PACKAGE_GLM
	help
	  RSXS screensaver add-ons for Kodi

	  https://github.com/xbmc/screensavers.rsxs
```

## package/kodi-vfs-nfs/Config.in
```kconfig
config BR2_PACKAGE_KODI_VFS_NFS
	bool "kodi-vfs-nfs"
	# libnfs -> libtirpc
	depends on BR2_TOOLCHAIN_HAS_NATIVE_RPC || BR2_TOOLCHAIN_HAS_THREADS
	select BR2_PACKAGE_LIBNFS
	select BR2_PACKAGE_LIBPLATFORM
	help
	  NFS VFS addon for Kodi

	  https://github.com/notspiff/vfs.nfs

comment "kodi-vfs-nfs needs a toolchain w/ threads support"
	depends on !(BR2_TOOLCHAIN_HAS_THREADS || BR2_TOOLCHAIN_HAS_NATIVE_RPC)
```

## package/kodi-vfs-rar/Config.in
```kconfig
config BR2_PACKAGE_KODI_VFS_RAR
	bool "kodi-vfs-rar"
	select BR2_PACKAGE_LIBPLATFORM
	select BR2_PACKAGE_KODI_PLATFORM
	help
	  RAR VFS addon for Kodi

	  https://github.com/notspiff/vfs.rar
```

## package/libinput/Config.in
```kconfig
config BR2_PACKAGE_LIBINPUT
	bool "libinput"
	select BR2_PACKAGE_LIBEVDEV
	select BR2_PACKAGE_LIBUDEV
	select BR2_PACKAGE_MTDEV
	select BR2_PACKAGE_LIBUDEV
	help
	  libinput is a library to handle input devices in Wayland
	  compositors and to provide a generic X.Org input driver.
	  It provides device detection, device handling, input device
	  event processing and abstraction so minimize the amount of
	  custom input code compositors need to provide the common
	  set of functionality that users expect.

	  http://freedesktop.org/wiki/Software/libinput/
```

## package/neptune/Config.in
```kconfig
config BR2_PACKAGE_NEPTUNE
	bool "neptune"
	depends on BR2_INSTALL_LIBSTDCPP
	depends on !BR2_STATIC_LIBS # dlfcn.h
	depends on BR2_TOOLCHAIN_HAS_THREADS # pthread
	help
	  Neptune Portable C++ Runtime Library

	  https://github.com/axiomatic-systems/Neptune

comment "neptune needs a toolchain w/ C++, threads, dynamic library"
	depends on !BR2_INSTALL_LIBSTDCPP || !BR2_TOOLCHAIN_HAS_THREADS || \
		BR2_STATIC_LIBS
```

## package/openjdk/Config.in.host
```kconfig
config BR2_PACKAGE_OPENJDK
	bool "host openjdk"
	select BR2_PACKAGE_HOST_OPENJDK_BOOTSTRAP
	help
	  OpenJDK (Open Java Development Kit) is a free and open source
	  implementation of the Java Platform, Standard Edition

	  http://openjdk.java.net
```

## package/platinum/Config.in
```kconfig
config BR2_PACKAGE_PLATINUM
	bool "platinum"
	depends on BR2_INSTALL_LIBSTDCPP
	depends on !BR2_STATIC_LIBS # neptune
	depends on BR2_TOOLCHAIN_HAS_THREADS # neptune
	select BR2_PACKAGE_NEPTUNE
	help
	  UPnP SDK

	  https://www.plutinosoft.com/platinum/

comment "platinum needs a toolchain w/ C++, threads, dynamic library"
	depends on !BR2_INSTALL_LIBSTDCPP || !BR2_TOOLCHAIN_HAS_THREADS || \
		BR2_STATIC_LIBS
```
